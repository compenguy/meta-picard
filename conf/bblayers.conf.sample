## conf/bblayers.conf.sample
```bitbake
# LAYER_CONF_VERSION is increased each time build/conf/bblayers.conf
# changes incompatibly
LCONF_VERSION = "6"

BBPATH = "${TOPDIR}"
BBFILES ?= ""

BBLAYERS ?= " \
  ##OEROOT##/meta \
  ##OEROOT##/../meta-openembedded/meta-oe \
  ##OEROOT##/../meta-openembedded/meta-networking \
  ##OEROOT##/../meta-openembedded/meta-python \
  ##OEROOT##/../meta-raspberrypi \
  ##OEROOT##/../meta-rust \
  ##OEROOT##/../meta-picard \
  "

BBLAYERS_NON_REMOVABLE ?= " \
  ##OEROOT##/meta \
  ##OEROOT##/../meta-openembedded/meta-oe \
  "
```

## conf/distro/picard.conf
```bitbake
# Copyright 2020 Will Page <compenguy@gmail.com>
# SPDX-License-Identifier: MIT
MAINTAINER = "Will Page <compenguy@gmail.com>"

DISTRO = "picard"
DISTRO_NAME = "picard"
DISTRO_VERSION = "2023.10"
DISTRO_VERSION[vardepsexclude] = "DATE"
DISTRO_CODENAME = "buick"

SDK_VERSION = "${@d.getVar('DISTRO_VERSION').replace('snapshot-${DATE}','snapshot')}"
SDK_VERSION[vardepsexclude] = "DATE"
SDK_NAME = "${DISTRO}-${TCLIBC}-${SDKMACHINE}-${IMAGE_BASENAME}-${TUNE_PKGARCH}-${MACHINE}"
SDKPATH = "/opt/${DISTRO}/${SDK_VERSION}"

DISTRO_FEATURES_DEFAULT = "acl bluetooth ext2 ipv4 ipv6 lto overlayfs pam systemd usbhost xattr"
DISTRO_FEATURES:append = " ${EXTRA_DISTRO_FEATURES}"
DISTRO_FEATURES:append = " ldconfig polkit keyboard "
DISTRO_EXTRA_RDEPENDS:append = " tzdata"
DISTRO_EXTRA_RRECOMMENDS:append = ""

# block the silent, automatic addition of pulseaudio which we don't actually want
DISTRO_FEATURES_BACKFILL_CONSIDERED:append = " pulseaudio"

# Merge /bin and /lib with /usr/bin and /usr/lib (respectively)
# Kernel will need to be told to search a new path for firmware because the
# firmware loader gets confused by the symlinks connecting /lib to /usr/lib
DISTRO_FEATURES:append = " usrmerge"
KERNEL_ARGS:append = " ${@bb.utils.contains("DISTRO_FEATURES", "usrmerge", "firmware_class.path=/usr/lib/firmware", "", d)}"

# Use systemd as init
# https://docs.yoctoproject.org/dev-manual/init-manager.html?highlight=init_manager
INIT_MANAGER = "systemd"
VIRTUAL-RUNTIME_syslog = ""
VIRTUAL-RUNTIME_base-utils-syslog = ""

# Replace/remove busybox
#PREFERRED_PROVIDER:virtual/base-utils = "packagegroup-core-base-utils"
#VIRTUAL-RUNTIME:login_manager = "shadow-base"
#VIRTUAL-RUNTIME:base-utils = "packagegroup-core-base-utils"
#VIRTUAL-RUNTIME:base-utils-hwclock = "util-linux-hwclock"
#VIRTUAL-RUNTIME:base-utils-syslog = ""

# Set default hostname for distro
hostname:pn-base-files = "picard"

# Set raspberrypi boot parameters
# Remove the black border around the video output to compensate for TVs which cut off part of the image
DISABLE_OVERSCAN = "1"

# Raspberry pi boot delay
#
# Allow extra time for sd card to come up before trying to boot off it, if the
# hardware is slow to become ready
BOOT_DELAY = "0"

# Raspberry pi GPU memory
GPU_MEM = "16"

# Raspberry pi GPU boot splash screen
DISABLE_SPLASH = "1"

# Raspberry pi boot logo
DISABLE_RPI_BOOT_LOGO = "1"

# Enable USB host and OTG support
#
# By default in case of the Compute Module 4 IO Board the standard USB driver
# that usually supports host mode operations is disabled for power saving
# reasons. Users who want to use the 2 USB built-in ports or the other ports
# provided via the header extension should set the following in local.conf:
ENABLE_DWC2_HOST = "1"
ENABLE_DWC2_OTG = "1"

# Manually set extra config values
# Disable triggers for LEDS
RPI_EXTRA_CONFIG += "\ndtparam=act_led_trigger=none"
RPI_EXTRA_CONFIG += "\ndtparam=pwr_led_trigger=none"
# Some boot speed enhancements
RPI_EXTRA_CONFIG += "\ninitial_turbo=20"
RPI_EXTRA_CONFIG += "\ndtoverlay=pi3-disable-wifi"
# Overclock the SD card from 50 to 100MHz" >> ${DEPLOYDIR}/bcm2835-bootfiles/config.txt
# this can only be done with at least a UHS Class 1 card" >> ${DEPLOYDIR}/bcm2835-bootfiles/config.txt
RPI_EXTRA_CONFIG += "\ndtoverlay=sdtweak,overclock_50=100"

# Set the rust version, because openembedded-core/meta sets it to some really old version
RUSTVERSION ?= "1.66%"

# Host linux distributions on which this build has been successfully tested on
SANITY_TESTED_DISTROS ?= " \
    ubuntu-22.04 \n \
    "
LOCALCONF_VERSION = "1"
```

## conf/layer.conf
```bitbake
# Copyright 2020 Will Page <compenguy@gmail.com>
# SPDX-License-Identifier: MIT

# We have a conf and classes directory, add to BBPATH
BBPATH .= ":${LAYERDIR}"

# We have recipes-* directories, add to BBFILES
BBFILES += "${LAYERDIR}/recipes-*/*/*.bb \
            ${LAYERDIR}/recipes-*/*/*.bbappend"

BBFILE_COLLECTIONS += "meta-picard"
BBFILE_PATTERN_meta-picard = "^${LAYERDIR}/"
BBFILE_PRIORITY_meta-picard = "6"

LAYERDEPENDS_meta-picard = "core"
LAYERDEPENDS_meta-picard += "rust-layer"
LAYERSERIES_COMPAT_meta-picard = "dunfell"
```
